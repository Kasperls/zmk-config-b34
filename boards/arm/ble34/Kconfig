## boards/arm/ble34/Kconfig
```kconfig
#
# Copyright (c) 2022 The ZMK Contributors
# SPDX-License-Identifier: MIT
#

config BOARD_ENABLE_DCDC
    bool "Enable DCDC mode"
    select SOC_DCDC_NRF52X
    default y
    depends on (BOARD_BLE34_LEFT || BOARD_BLE34_RIGHT)

config BOARD_ENABLE_DCDC_HV
    bool "Enable High Voltage DCDC converter"
    select SOC_DCDC_NRF52X_HV
    default y
    depends on (BOARD_BLE34_LEFT || BOARD_BLE34_RIGHT)
```

## boards/arm/ble34/Kconfig.board
```kconfig
#
# Copyright (c) 2022 Darryl deHaan
# SPDX-License-Identifier: MIT
#

config BOARD_BLE34_LEFT
    bool "ble34 left"
    depends on SOC_NRF52840_QIAA

config BOARD_BLE34_RIGHT
    bool "ble34 right"
    depends on SOC_NRF52840_QIAA
```
